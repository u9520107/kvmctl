## firmware/main/Kconfig.projbuild
```kconfig
menu "kvmctl hardware profile"

choice KVMCTL_RGB_LED_PROFILE
    prompt "Onboard addressable RGB LED"
    default KVMCTL_RGB_LED_GPIO48

config KVMCTL_RGB_LED_GPIO48
    bool "GPIO48 (ESP32-S3-DevKitC-1 v1.0 profile)"

config KVMCTL_RGB_LED_GPIO38
    bool "GPIO38 (ESP32-S3-DevKitC-1 v1.1 profile)"

config KVMCTL_RGB_LED_UNSUPPORTED
    bool "No supported onboard RGB LED"

endchoice

endmenu
```

## firmware/sdkconfig.defaults
```kconfig
CONFIG_IDF_TARGET="esp32s3"
CONFIG_ESPTOOLPY_FLASHSIZE_16MB=y
CONFIG_ESPTOOLPY_FLASHMODE_DIO=y
CONFIG_ESPTOOLPY_FLASHFREQ_80M=y
CONFIG_SPIRAM=y
CONFIG_SPIRAM_MODE_OCT=y
CONFIG_SPIRAM_TYPE_ESPPSRAM64=y
CONFIG_SPIRAM_SPEED_80M=y
CONFIG_ESP_DEFAULT_CPU_FREQ_MHZ_160=y
CONFIG_ESP_MAIN_TASK_STACK_SIZE=12288
CONFIG_FREERTOS_GENERATE_RUN_TIME_STATS=y
CONFIG_FREERTOS_RUN_TIME_STATS_USING_ESP_TIMER=y
CONFIG_PARTITION_TABLE_SINGLE_APP_LARGE=y
CONFIG_MBEDTLS_SSL_PROTO_DTLS=y
CONFIG_MBEDTLS_EXTERNAL_MEM_ALLOC=y
CONFIG_MBEDTLS_SSL_DTLS_SRTP=y
CONFIG_MBEDTLS_X509_CREATE_C=y
CONFIG_ESP_HTTPS_SERVER_ENABLE=y
CONFIG_ESP_HTTPS_SERVER_CERT_SELECT_HOOK=y
CONFIG_HTTPD_WS_SUPPORT=y
CONFIG_HTTPD_WS_STRICTER_RFC6455=y
CONFIG_HTTPD_WS_PRE_HANDSHAKE_CB_SUPPORT=y
CONFIG_HTTPD_WS_POST_HANDSHAKE_CB_SUPPORT=y
CONFIG_HTTPD_MAX_REQ_HDR_LEN=1024
```

## verification/m0/usb-hid-uart/sdkconfig.defaults
```kconfig
CONFIG_TINYUSB_HID_COUNT=1
CONFIG_ESP_WIFI_NVS_ENABLED=n
CONFIG_ESPTOOLPY_FLASHSIZE_16MB=y
CONFIG_SPIRAM=y
CONFIG_SPIRAM_MODE_OCT=y
CONFIG_SPIRAM_TYPE_ESPPSRAM64=y
CONFIG_SPIRAM_SPEED_80M=y
```
